# STM32WBA62 register map
File version: 1.1
CPU: CM33 r0p1, little endian, MPU, FPU, 4 interrupt priority bits
Registers are 32-bit, read-write, reset 0x0 unless marked. A register's access mark holds for its fields unless they carry their own. Offsets are from the block's base; lines under a group give offsets from that group; [hi:lo] are bit positions; {n}, {i} and the like mark numbered series; 'fields as' and 'values as' point back to an identical list; <NAME> marks a mode.

## Memory map
0x40000000 TIM2 size 0x3E4 — TIM2 address block description
0x40000400 TIM3 size 0x3E4 — TIM3 address block description
0x40000800 TIM4 size 0x3E4 — TIM4 address block description
0x40002C00 WWDG size 0xC — WWDG address block description
0x40003000 IWDG size 0x18 — IWDG address block description
0x40003800 SPI2 size 0x50
0x40004400 USART2 size 0x34
0x40004800 USART3 size 0x34
0x40005400 I2C1 size 0x30 — I2C1 address block description
0x40005800 I2C2 size 0x30
0x40008400 I2C4 size 0x30
0x40009400 LPTIM2 size 0x38 — LPTIM2 address block description
0x40012C00 TIM1 size 0x3E4 — TIM1 address block description
0x40013000 SPI1 size 0x50 — SPI1 address block description
0x40013800 USART1 size 0x34 — USART1 address block description
0x40014400 TIM16 size 0x3E4 — TIM16 address block description
0x40014800 TIM17 size 0x3E4 — TIM17 address block description
0x40015400 SAI1 size 0x400 — SAI1 register block
0x40020000 GPDMA size 0x1000 — GPDMA register block
0x40022000 FLASH size 0x400 — FLASH register block
0x40023000 CRC size 0x18 — CRC address block description
0x40024000 TSC size 0x54 — TSC address block description
0x40026000 RAMCFG size 0x6C — RAMCFG address block description
0x40030400 ICACHE size 0x400 — ICACHE register block
0x40032400 GTZC_TZSC size 0x2C — GTZC_TZSC address block description
0x40032800 GTZC_TZIC size 0x30 — GTZC_TZIC address block description
0x40032C00 GTZC_MPCBB1 size 0x270 — GTZC_MPCBB1 address block description
0x40033000 GTZC_MPCBB2 size 0x270
0x40034000 GTZC_MPCBB6 size 0x204 — GTZC_MPCBB6 address block description
0x42020000 GPIOA size 0x34 — GPIOA address block description
0x42020400 GPIOB size 0x34 — GPIOB address block description
0x42020800 GPIOC size 0x34 — GPIOC address block description
0x42020C00 GPIOD size 0x34 — GPIOD address block description
0x42021000 GPIOE size 0x34 — GPIOE address block description
0x42021800 GPIOG size 0x34 — GPIOG address block description
0x42021C00 GPIOH size 0x34 — GPIOH address block description
0x42040000 OTG size 0xE08 — OTG address block description
0x420C0000 AES size 0x400 — AES register block
0x420C0400 HASH size 0x330 — HASH address block description
0x420C0800 RNG size 0x14 — RNG address block description
0x420C0C00 SAES size 0x400 — SAES register block
0x420C1C00 HSEM size 0x238 — HSEM address block description
0x420C2000 PKA size 0x2000 — PKA register blank and RAM
0x46000400 SYSCFG size 0x80 — SYSCFG address block description
0x46002000 SPI3 size 0x50
0x46002400 LPUART1 size 0x34 — LPUART1 address block description
0x46002800 I2C3 size 0x30
0x46004400 LPTIM1 size 0x38 — LPTIM1 address block description
0x46005400 COMP size 0x8 — COMP address block description
0x46007400 VREFBUF size 0x8 — VREFBUF address block description
0x46007800 RTC size 0x400 — RTC register block
0x46007C00 TAMP size 0x400 — TAMP register block
0x46020800 PWR size 0x108 — PWR address block description
0x46020C00 RCC size 0x214 — RCC address block description
0x46021000 ADC4 size 0x30C — ADC4 address block description
0x46022000 EXTI size 0x88 — EXTI address block description
0x48038000 PTACONV size 0x400 — PTACONV register block
0x50000000 SEC_TIM2 size 0x3E4
0x50000400 SEC_TIM3 size 0x3E4
0x50000800 SEC_TIM4 size 0x3E4
0x50002C00 SEC_WWDG size 0xC
0x50003000 SEC_IWDG size 0x18
0x50003800 SEC_SPI2 size 0x50
0x50004400 SEC_USART2 size 0x34
0x50004800 SEC_USART3 size 0x34
0x50005400 SEC_I2C1 size 0x30
0x50005800 SEC_I2C2 size 0x30
0x50008400 SEC_I2C4 size 0x30
0x50009400 SEC_LPTIM2 size 0x38
0x50012C00 SEC_TIM1 size 0x3E4
0x50013000 SEC_SPI1 size 0x50
0x50013800 SEC_USART1 size 0x34
0x50014400 SEC_TIM16 size 0x3E4
0x50014800 SEC_TIM17 size 0x3E4
0x50015400 SEC_SAI1 size 0x400
0x50020000 SEC_GPDMA size 0x1000
0x50022000 SEC_FLASH size 0x400
0x50023000 SEC_CRC size 0x18
0x50024000 SEC_TSC size 0x54
0x50026000 SEC_RAMCFG size 0x6C
0x50030400 SEC_ICACHE size 0x400
0x50032400 SEC_GTZC_TZSC size 0x2C
0x50032800 SEC_GTZC_TZIC size 0x30
0x50032C00 SEC_GTZC_MPCBB1 size 0x270
0x50033000 SEC_GTZC_MPCBB2 size 0x270
0x50034000 SEC_GTZC_MPCBB6 size 0x204
0x52020000 SEC_GPIOA size 0x34
0x52020400 SEC_GPIOB size 0x34
0x52020800 SEC_GPIOC size 0x34
0x52020C00 SEC_GPIOD size 0x34
0x52021000 SEC_GPIOE size 0x34
0x52021800 SEC_GPIOG size 0x34
0x52021C00 SEC_GPIOH size 0x34
0x52040000 SEC_OTG size 0xE08
0x520C0000 SEC_AES size 0x400
0x520C0400 SEC_HASH size 0x330
0x520C0800 SEC_RNG size 0x14
0x520C0C00 SEC_SAES size 0x400
0x520C1C00 SEC_HSEM size 0x238
0x520C2000 SEC_PKA size 0x2000
0x56000400 SEC_SYSCFG size 0x80
0x56002000 SEC_SPI3 size 0x50
0x56002400 SEC_LPUART1 size 0x34
0x56002800 SEC_I2C3 size 0x30
0x56004400 SEC_LPTIM1 size 0x38
0x56005400 SEC_COMP size 0x8
0x56007400 SEC_VREFBUF size 0x8
0x56007800 SEC_RTC size 0x400
0x56007C00 SEC_TAMP size 0x400
0x56020800 SEC_PWR size 0x108
0x56020C00 SEC_RCC size 0x214
0x56021000 SEC_ADC4 size 0x30C
0x56022000 SEC_EXTI size 0x88
0x58038000 SEC_PTACONV size 0x400
0xE0044000 DBGMCU size 0x1000 — DBGMCU address block description

## Interrupts
0 WWDG — Window Watchdog interruptt
1 EXTI1_PVD (EXTI) — PVD through EXTI[16]
2 RTC — RTC global non-secure interrupt
3 RTC_S (SEC_RTC) — RTC global secure interrupt
4 TAMP — Tamper global interrupt
5 RAMCFG — RAM configutration CID0 global interrupt
6 Flash (FLASH) — Flash non-secure global interrupt Flash ECC single error correction interrupt
7 Flash_S (SEC_FLASH) — Flash secure global interrupt
8 GTZC_TZIC — GTZC_TZIC global illegal access interrupt
9 RCC — RCC non-secure global interrupt
10 RCC_S (SEC_RCC) — RCC secure global interrupt
{n+11} EXTI{n} (EXTI) (n=0..15) — EXTI Line{n} interrupt through EXTI[{n}]
27 IWDG — Independent watchdog interrupt
28 SAES — Secure AES interrupt
{n+29} GPDMA1_CH{n} (GPDMA) (n=0..7) — GPDMA1 channel {n} interrupt
37 TIM1_BRK_TIM1_TERR_TIM1_IERR (TIM1) — TIM1 Break interrupt/TIM1 Transition error/TIM1 index error
38 TIM1_UP (TIM1) — TIM1 Update interrupt
39 TIM1_TRG_COM_TIM1_DIR_TIM1_IDX (TIM1) — TIM1 trigger and communication interrupt/TIM1 direction change interrupt/TIM1 index
40 TIM1_CC (TIM1) — TIM1 capture compare interrupt
41 TIM2 — TIM2 global interrupt
42 TIM3 — TIM3 global interrupt
43 I2C1_EV (I2C1) — I2C1 event interrupt
44 I2C1_ER (I2C1) — I2C1 error interrupt
45 SPI1 — SPI1 global interrupt
46 USART1 — USART1 global interrupt
47 USART2 — USART2 global interrupt
48 LPUART1 — LPUART1 global interrupt
49 LPTIM1 — LPTIM1 global interrupt
50 LPTIM2 — LPTIM2 global interrupt
51 TIM16 — TIM16 global interrupt
52 TIM17 — TIM17 global interrupt
54 I2C3_EV (I2C3) — I2C3 event interrupt
55 I2C3_ER (I2C3) — I2C3 error interrupt
56 SAI1 — SAI1 global interrupt
57 TSC — TSC global interrupt
58 AES — AES global interrupt
59 RNG — True random number generator interrupt
60 FPU (EXTI) — Floating point interrupt
61 HASH — HASH global interrupt
62 PKA — PKA global interrupt
63 SPI3 — SPI3 global interrupt
64 ICACHE — Instruction cache global interrupt
65 ADC4 — ADC4 global interrupt
68 HSEM — HSEM non-secure interrupt
69 HSEM_S (SEC_HSEM) — HSEM secure interrupt
71 RCC_AUDIO (RCC) — RCC AUDIO synchronisation interrupt
72 TIM4 — TIM4 global interrupt
73 I2C2_EV (I2C2) — I2C2 event interrupt
74 I2C2_ER (I2C2) — I2C2 error interrupt
75 SPI2 — SPI2 global interruptS
76 OTG_HS (OTG) — USB OTG HS global interrupt
77 I2C4_EV (I2C4) — I2C4 event interrupt
78 I2C4_ER (I2C4) — I2C4 error interrupt
79 USART3 — USART3 global interrupt
80 EXTI19_RADIO_IO6 (EXTI) — 2.4 GHz RADIO general purpose interrupt 6 through EXTI[19]
81 EXTI20_RADIO_IO7 (EXTI) — 2.4 GHz RADIO general purpose interrupt 7 through EXTI[20]

## Notices in the file
Copyright (c) 2025 STMicroelectronics.
SPDX-License-Identifier: Apache-2.0
Licensed under the Apache License, Version 2.0 (the "License");
you may not use this file except in compliance with the License.
You may obtain a copy of the License at
http://www.apache.org/licenses/LICENSE-2.0
Unless required by applicable law or agreed to in writing, software
distributed under the License is distributed on an "AS IS" BASIS,
WITHOUT WARRANTIES OR CONDITIONS OF ANY KIND, either express or implied.
See the License for the specific language governing permissions and
limitations under the License.
